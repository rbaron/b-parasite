## code/nrf-connect/boards/arm/bparasite_nrf52840/Kconfig.board
```kconfig
config BOARD_BPARASITE_NRF52840
	bool "b-parasite nRF52840 board"
	depends on SOC_NRF52840_QIAA
```

## code/nrf-connect/prstlib/Kconfig
```kconfig
module = PRSTLIB
module-str = prstlib
source "subsys/logging/Kconfig.template.log_config"
```

## code/nrf-connect/prstlib/boards/arm/bparasite_nrf52833/Kconfig
```kconfig
if BOARD_BPARASITE_NRF52833

config BOARD_ENABLE_DCDC
	bool "DCDC mode"
	select SOC_DCDC_NRF52X
	default y

endif  # BOARD_BPARASITE_NRF52833
```

## code/nrf-connect/prstlib/boards/arm/bparasite_nrf52833/Kconfig.board
```kconfig
config BOARD_BPARASITE_NRF52833
	bool "b-parasite nRF52833 board"
	depends on SOC_NRF52833_QIAA
```

## code/nrf-connect/prstlib/boards/arm/bparasite_nrf52833/Kconfig.defconfig
```kconfig
if BOARD_BPARASITE_NRF52833

config BOARD
	default "bparasite_nrf52833"

config BOARD_REVISION
	string "Board revision."
	default "1.0.0"

config BOARD_REVISION_CODE
	int "Board revision code. An integer representation of the board revision."
	default 1

config BT_CTLR
	default BT

endif  # BOARD_BPARASITE_NRF52833
```

## code/nrf-connect/prstlib/boards/arm/bparasite_nrf52840/Kconfig
```kconfig
if BOARD_BPARASITE_NRF52840

config BOARD_ENABLE_DCDC
	bool "DCDC mode"
	select SOC_DCDC_NRF52X
	default y

config BOARD_ENABLE_DCDC_HV
	bool "High Voltage DCDC converter"
	select SOC_DCDC_NRF52X_HV
	default y

endif  # BOARD_BPARASITE_NRF52840
```

## code/nrf-connect/prstlib/boards/arm/bparasite_nrf52840/Kconfig.defconfig
```kconfig
if BOARD_BPARASITE_NRF52840

config BOARD
	default "bparasite_nrf52840"

config BOARD_REVISION
	string "Board revision."
	default "1.0.0"

config BT_CTLR
	default BT

endif  # BOARD_BPARASITE_NRF52840
```

## code/nrf-connect/prstlib/boards/arm/bparasite_nrf52840/bparasite_nrf52840_defconfig
```kconfig
CONFIG_SOC_SERIES_NRF52X=y
CONFIG_SOC_NRF52840_QIAA=y
CONFIG_BOARD_BPARASITE_NRF52840=y

# Enable MPU
CONFIG_ARM_MPU=y

# Enable RTT
CONFIG_USE_SEGGER_RTT=y

# enable GPIO
CONFIG_GPIO=y

# enable console
CONFIG_CONSOLE=y
CONFIG_RTT_CONSOLE=y

CONFIG_PINCTRL=y
```

## code/nrf-connect/prstlib/boards/bparasite/Kconfig
```kconfig
if BOARD_BPARASITE

config BOARD_ENABLE_DCDC
	bool "DCDC mode"
	select SOC_DCDC_NRF52X
	default y

endif  # BOARD_BPARASITE
```

## code/nrf-connect/prstlib/boards/bparasite/Kconfig.bparasite
```kconfig
config BOARD_BPARASITE
	bool "b-parasite board"
	select SOC_NRF52833_QIAA if BOARD_BPARASITE_NRF52833
	select SOC_NRF52840_QIAA if BOARD_BPARASITE_NRF52840
```

## code/nrf-connect/prstlib/boards/bparasite/Kconfig.defconfig
```kconfig
if BOARD_BPARASITE

config BOARD
	default "bparasite"

config BOARD_REVISION
	string "Board revision."
	default "1.0.0"

config BOARD_REVISION_CODE
	int "Board revision code. An integer representation of the board revision."
	default 1

config BT_CTLR
	default BT

endif  # BOARD_BPARASITE
```

## code/nrf-connect/prstlib/boards/bparasite/board.yml
```yaml
board:
  name: bparasite
  socs:
    - name: nrf52833
    - name: nrf52840
  revision:
    format: major.minor.patch
    default: "2.0.0"
    revisions:
      - name: "1.0.0"
      - name: "1.1.0"
      - name: "1.2.0"
      - name: "2.0.0"
```

## code/nrf-connect/prstlib/boards/bparasite/bparasite_nrf52833_defconfig
```kconfig
# Enable MPU
CONFIG_ARM_MPU=y

# Enable RTT
CONFIG_USE_SEGGER_RTT=y

# enable GPIO
CONFIG_GPIO=y

# enable console
CONFIG_CONSOLE=y
CONFIG_RTT_CONSOLE=y

CONFIG_PINCTRL=y
```

## code/nrf-connect/prstlib/dts/bindings/pwm-fixed.yaml
```yaml
description: A fixed frequency & pulse PWM.

compatible: pwm-fixed

include: base.yaml

properties:
  pwms:
    type: phandle-array
    required: true
    description: the PWM spec.

  pulse:
    required: true
    type: int
    description: The period of the PWM pulse.
```

## code/nrf-connect/prstlib/dts/bindings/soil-calibration-coeffs.yaml
```yaml
description: >
  Calibration coefficients for the soil sensing circuit. We have two polynomials whose input variable
  is the battery voltage in Volts. The evaluated polynomial corresponds to the estimated ADC value,
  assumed to be 10 bits, so in [0, 1024). The two polynomials are:
    dry: For estimation of the fully dry state, given the battery voltage
    wet: For estimation of the fully dry state, given the battery voltage

  Note that each poly coefficient is specified as 1000 times its real values. This is because we can't
  directly represent floating points in devicetree. The final evaluated value should be divided by
  1000.0f in code.

compatible: soil-calibration-coeffs

include: base.yaml

properties:
  dry:
    type: array
    required: true
    description: The coefficients * 1000, as integers. 0th degree first, then 1st and 2nd last.
  wet:
    type: array
    required: true
    description: The coefficients * 1000, as integers. 0th degree first, then 1st and 2nd last.
```

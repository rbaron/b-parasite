## CMakeLists.txt
```
cmake_minimum_required(VERSION 3.20.0)

# Pull in the dts/ and boards/ from prstlib.
set(DTS_ROOT ${CMAKE_CURRENT_SOURCE_DIR}/../../prstlib)
set(BOARD_ROOT ${CMAKE_CURRENT_SOURCE_DIR}/../../prstlib)

find_package(Zephyr REQUIRED HINTS $ENV{ZEPHYR_BASE})

project("b-parasite Zigbee sample")

include_directories(src)

target_sources(app PRIVATE
  src/main.c
  src/debug_counters.c
  src/double_reset_detector.c
  src/factory_reset.c
  src/flash_fs.c
  src/prst_zb_attrs.c
  src/prst_zb_soil_moisture_defs.c
  src/restart_handler.c
  src/watchdog.c
)

add_subdirectory(../../prstlib prstlib)
target_include_directories(app PRIVATE ../../prstlib/include)
target_link_libraries(app PUBLIC prstlib)
```

## Kconfig
```
source "Kconfig.zephyr"
rsource "../../prstlib/Kconfig"

config PRST_ZB_SLEEP_DURATION_SEC
	int "Sleep duration between waking up and reading sensors in seconds."
	default 60

config PRST_ZB_PARENT_POLL_INTERVAL_SEC
	int "Interval for when b-parasite polls its parent for data in seconds."
	default 10

config PRST_ZB_BUILD_DATE
  string "Zigbee basic cluster build date attribute. Max 16 bytes."
  default ""

config PRST_ZB_SOFTWARE_VERSION
  string "Zigbee basic cluster software version attribute. Max 16 bytes."
  default ""

config PRST_ZB_MODEL_ID
  string "Zigbee basic cluster model id attribute. Max 32 bytes."
  default "b-parasite"

config PRST_ZB_HARDWARE_VERSION
  int "Zigbee basic cluster hardware version attribute. 1 byte."
  default BOARD_REVISION_CODE

choice PRST_ZB_FACTORY_RESET_METHOD
  bool "Factory reset method"
  default PRST_ZB_FACTORY_RESET_VIA_SW1

config PRST_ZB_FACTORY_RESET_VIA_DOUBLE_RESET
  bool "Double resetting factory resets the device."

config PRST_ZB_FACTORY_RESET_VIA_RESET_PIN
  bool "Resetting via the reset pin will factory reset the device. Power cycling through battery replacement will not."

config PRST_ZB_FACTORY_RESET_VIA_SW1
  bool "Resetting while pressing and holding SW1 for 5 seconds will factory reset the device. Only available on v2.0.0+ hardware revisions."

config PRST_ZB_FACTORY_RESET_DISABLED
  bool "No factory reset procedure."

endchoice  # PRST_ZB_FACTORY_RESET_METHOD

config PRST_ZB_RESTART_WATCHDOG_TIMEOUT_SEC
    int "Duration after the device will restart the rejoin procedure if a network has not been successfully joined."
    default 3600
```

## prj.conf
```kconfig
CONFIG_LOG=y
CONFIG_PWM=y
CONFIG_I2C=y
CONFIG_ADC=y
CONFIG_GPIO=y

CONFIG_USE_SEGGER_RTT=y
CONFIG_SEGGER_RTT_BUFFER_SIZE_UP=4096

CONFIG_NEWLIB_LIBC=y
CONFIG_NEWLIB_LIBC_FLOAT_PRINTF=y

CONFIG_SERIAL=n

CONFIG_HEAP_MEM_POOL_SIZE=2048
CONFIG_MAIN_THREAD_PRIORITY=7

CONFIG_ZIGBEE=y
CONFIG_ZIGBEE_APP_UTILS=y
CONFIG_ZIGBEE_ROLE_END_DEVICE=y

# This example requires more workqueue stack
CONFIG_SYSTEM_WORKQUEUE_STACK_SIZE=2048

# Enable nRF ECB driver
CONFIG_CRYPTO=y
CONFIG_CRYPTO_NRF_ECB=y
CONFIG_CRYPTO_INIT_PRIORITY=80

# Networking
CONFIG_NET_IPV6=n
CONFIG_NET_IPV6_MLD=n
CONFIG_NET_IPV6_NBR_CACHE=n
CONFIG_NET_IPV6_RA_RDNSS=n
CONFIG_NET_IP_ADDR_CHECK=n
CONFIG_NET_UDP=n

##
## ZigBee Channel Selection
##
# Get Zigbee to scan every channel.
CONFIG_ZIGBEE_CHANNEL_SELECTION_MODE_MULTI=y
# By default only scans channel 11 (ZigBee2MQTT default) and 15 (ZHA default).
# Comment to scan all channels - this will make pairing consume more energy.
# CONFIG_ZIGBEE_CHANNEL_MASK=0x8800

# Uncomment to set a specific channel - this will make pairing more energy efficient.
# CONFIG_ZIGBEE_CHANNEL=11

# Enable API for powering down unused RAM parts.
# https://developer.nordicsemi.com/nRF_Connect_SDK/doc/1.7.1/nrf/ug_zigbee_configuring.html#power-saving-during-sleep
CONFIG_RAM_POWER_DOWN_LIBRARY=y

# LittleFS.
CONFIG_MAIN_STACK_SIZE=2048
CONFIG_FLASH=y
CONFIG_FLASH_MAP=y
CONFIG_FLASH_PAGE_LAYOUT=y
CONFIG_FILE_SYSTEM=y
CONFIG_FILE_SYSTEM_LITTLEFS=y

CONFIG_WATCHDOG=y
CONFIG_HWINFO=y
CONFIG_ASSERT=y

# Uncomment for debug log level.
# CONFIG_LOG_DEFAULT_LEVEL=4

# Factory reset method selection. Only hardware revision 2.0.0+ has button SW1. Earlier
# revisions must select a different method. See Kconfig for options.
# CONFIG_PRST_ZB_FACTORY_RESET_VIA_SW1=y
## OTA section

# OTA update configuration. This is based on the zigbee light switch example from the nrf-connect toolkit.
CONFIG_ZIGBEE_FOTA=n
CONFIG_ZIGBEE_FOTA_ENDPOINT=5
CONFIG_MCUBOOT_IMGTOOL_SIGN_VERSION="1.0.0" # Increase this version for generating an update for the devices.
CONFIG_ZIGBEE_FOTA_COMMENT="b_parasite"

# Ensure an MCUboot-compatible binary for ota update is generated.
CONFIG_IMG_MANAGER=y
CONFIG_STREAM_FLASH=y
CONFIG_DFU_TARGET_MCUBOOT=y
CONFIG_IMG_ERASE_PROGRESSIVELY=y
CONFIG_ZIGBEE_FOTA_PROGRESS_EVT=y

# Increase the number of RX buffers, as suggested by zigbee ota sample.
CONFIG_NRF_802154_RX_BUFFERS=32
```

## prj_debug.conf
```kconfig
CONFIG_LOG=y
CONFIG_PWM=y
CONFIG_I2C=y
CONFIG_ADC=y
CONFIG_GPIO=y

CONFIG_PM=y
CONFIG_PM_DEVICE=y

CONFIG_NEWLIB_LIBC=y
CONFIG_NEWLIB_LIBC_FLOAT_PRINTF=y

CONFIG_SERIAL=n

CONFIG_HEAP_MEM_POOL_SIZE=2048
CONFIG_MAIN_THREAD_PRIORITY=7

CONFIG_ZIGBEE=y
CONFIG_ZIGBEE_APP_UTILS=y
CONFIG_ZIGBEE_ROLE_END_DEVICE=y

# This example requires more workqueue stack
CONFIG_SYSTEM_WORKQUEUE_STACK_SIZE=2048

# Enable nRF ECB driver
CONFIG_CRYPTO=y
CONFIG_CRYPTO_NRF_ECB=y
CONFIG_CRYPTO_INIT_PRIORITY=80

# Networking
CONFIG_NET_IPV6_MLD=n
CONFIG_NET_IPV6_NBR_CACHE=n
CONFIG_NET_IPV6_RA_RDNSS=n
CONFIG_NET_IP_ADDR_CHECK=n
CONFIG_NET_UDP=n

# Get Zigbee to scan every channel.
CONFIG_ZIGBEE_CHANNEL_SELECTION_MODE_MULTI=y

# Enable API for powering down unused RAM parts.
# https://developer.nordicsemi.com/nRF_Connect_SDK/doc/1.7.1/nrf/ug_zigbee_configuring.html#power-saving-during-sleep
CONFIG_RAM_POWER_DOWN_LIBRARY=y

# Config options in Kconfig.
CONFIG_PRST_ZB_SLEEP_DURATION_SEC=10

CONFIG_LOG_DEFAULT_LEVEL=4
CONFIG_PRSTLIB_LOG_LEVEL_DBG=y
```

## prj_fota.conf
```kconfig
CONFIG_LOG=y
CONFIG_PWM=y
CONFIG_I2C=y
CONFIG_ADC=y
CONFIG_GPIO=y

CONFIG_USE_SEGGER_RTT=y
CONFIG_SEGGER_RTT_BUFFER_SIZE_UP=4096

CONFIG_NEWLIB_LIBC=y
CONFIG_NEWLIB_LIBC_FLOAT_PRINTF=y

CONFIG_SERIAL=n

CONFIG_HEAP_MEM_POOL_SIZE=2048
CONFIG_MAIN_THREAD_PRIORITY=7

CONFIG_ZIGBEE=y
CONFIG_ZIGBEE_APP_UTILS=y
CONFIG_ZIGBEE_ROLE_END_DEVICE=y

# This example requires more workqueue stack
CONFIG_SYSTEM_WORKQUEUE_STACK_SIZE=2048

# Enable nRF ECB driver
CONFIG_CRYPTO=y
CONFIG_CRYPTO_NRF_ECB=y
CONFIG_CRYPTO_INIT_PRIORITY=80

# Networking
CONFIG_NET_IPV6=n
CONFIG_NET_IPV6_MLD=n
CONFIG_NET_IPV6_NBR_CACHE=n
CONFIG_NET_IPV6_RA_RDNSS=n
CONFIG_NET_IP_ADDR_CHECK=n
CONFIG_NET_UDP=n

##
## ZigBee Channel Selection
##
# Get Zigbee to scan every channel.
CONFIG_ZIGBEE_CHANNEL_SELECTION_MODE_MULTI=y
# By default only scans channel 11 (ZigBee2MQTT default) and 15 (ZHA default).
# Comment to scan all channels - this will make pairing consume more energy.
# CONFIG_ZIGBEE_CHANNEL_MASK=0x8800

# Uncomment to set a specific channel - this will make pairing more energy efficient.
# CONFIG_ZIGBEE_CHANNEL=11

# Enable API for powering down unused RAM parts.
# https://developer.nordicsemi.com/nRF_Connect_SDK/doc/1.7.1/nrf/ug_zigbee_configuring.html#power-saving-during-sleep
CONFIG_RAM_POWER_DOWN_LIBRARY=y

# LittleFS.
CONFIG_MAIN_STACK_SIZE=2048
CONFIG_FLASH=y
CONFIG_FLASH_MAP=y
CONFIG_FLASH_PAGE_LAYOUT=y
CONFIG_FILE_SYSTEM=y
CONFIG_FILE_SYSTEM_LITTLEFS=y

CONFIG_WATCHDOG=y
CONFIG_HWINFO=y
CONFIG_ASSERT=y

# Uncomment for debug log level.
# CONFIG_LOG_DEFAULT_LEVEL=4

# Factory reset method selection. Only hardware revision 2.0.0+ has button SW1. Earlier
# revisions must select a different method. See Kconfig for options.
# CONFIG_PRST_ZB_FACTORY_RESET_VIA_SW1=y

##
## OTA section.
##

# Software build version in the basic_attrs cluster.
CONFIG_PRST_ZB_SOFTWARE_VERSION="test-sw-1"

# Enable Zigbee FOTA library
CONFIG_ZIGBEE_FOTA=y
CONFIG_ZIGBEE_FOTA_HW_VERSION=52
CONFIG_ZIGBEE_FOTA_ENDPOINT=5
CONFIG_MCUBOOT_IMGTOOL_SIGN_VERSION="1.0.0"
CONFIG_ZIGBEE_FOTA_COMMENT="b-parasite"

# Ensure an MCUboot-compatible binary is generated.
CONFIG_IMG_MANAGER=y
CONFIG_STREAM_FLASH=y
CONFIG_DFU_TARGET_MCUBOOT=y
CONFIG_IMG_ERASE_PROGRESSIVELY=y
CONFIG_ZIGBEE_FOTA_PROGRESS_EVT=y

# Increase the number of RX buffers
CONFIG_NRF_802154_RX_BUFFERS=32
```

## prj_ota.conf
```kconfig
CONFIG_LOG=y
CONFIG_PWM=y
CONFIG_I2C=y
CONFIG_ADC=y
CONFIG_GPIO=y

CONFIG_USE_SEGGER_RTT=y
CONFIG_SEGGER_RTT_BUFFER_SIZE_UP=4096

CONFIG_NEWLIB_LIBC=y
CONFIG_NEWLIB_LIBC_FLOAT_PRINTF=y

CONFIG_SERIAL=n

CONFIG_HEAP_MEM_POOL_SIZE=2048
CONFIG_MAIN_THREAD_PRIORITY=7

CONFIG_ZIGBEE=y
CONFIG_ZIGBEE_APP_UTILS=y
CONFIG_ZIGBEE_ROLE_END_DEVICE=y

# This example requires more workqueue stack
CONFIG_SYSTEM_WORKQUEUE_STACK_SIZE=2048

# Enable nRF ECB driver
CONFIG_CRYPTO=y
CONFIG_CRYPTO_NRF_ECB=y
CONFIG_CRYPTO_INIT_PRIORITY=80

# Networking
CONFIG_NET_IPV6=n
CONFIG_NET_IPV6_MLD=n
CONFIG_NET_IPV6_NBR_CACHE=n
CONFIG_NET_IPV6_RA_RDNSS=n
CONFIG_NET_IP_ADDR_CHECK=n
CONFIG_NET_UDP=n

##
## ZigBee Channel Selection
##
# Get Zigbee to scan every channel.
CONFIG_ZIGBEE_CHANNEL_SELECTION_MODE_MULTI=y
# By default only scans channel 11 (ZigBee2MQTT default) and 15 (ZHA default).
# Comment to scan all channels - this will make pairing consume more energy.
# CONFIG_ZIGBEE_CHANNEL_MASK=0x8800

# Uncomment to set a specific channel - this will make pairing more energy efficient.
# CONFIG_ZIGBEE_CHANNEL=15

# Enable API for powering down unused RAM parts.
# https://developer.nordicsemi.com/nRF_Connect_SDK/doc/1.7.1/nrf/ug_zigbee_configuring.html#power-saving-during-sleep
CONFIG_RAM_POWER_DOWN_LIBRARY=y

# LittleFS.
CONFIG_MAIN_STACK_SIZE=2048
CONFIG_FLASH=y
CONFIG_FLASH_MAP=y
CONFIG_FLASH_PAGE_LAYOUT=y
CONFIG_FILE_SYSTEM=y
CONFIG_FILE_SYSTEM_LITTLEFS=y

CONFIG_WATCHDOG=y
CONFIG_HWINFO=y
CONFIG_ASSERT=y

# Uncomment for debug log level.
# CONFIG_LOG_DEFAULT_LEVEL=4

# Factory reset method selection. Only hardware revision 2.0.0+ has button SW1. Earlier
# revisions must select a different method. See Kconfig for options.
# CONFIG_PRST_ZB_FACTORY_RESET_VIA_SW1=y
# Disable factory reset.

# OTA update configuration. This is based on the zigbee light switch example from the nrf-connect toolkit.
CONFIG_ZIGBEE_FOTA=y
CONFIG_ZIGBEE_FOTA_ENDPOINT=5
CONFIG_MCUBOOT_IMGTOOL_SIGN_VERSION="1.0.0" # Increase this version for generating an update for the devices.
CONFIG_ZIGBEE_FOTA_COMMENT="b_parasite"

# Ensure an MCUboot-compatible binary is generated.
CONFIG_IMG_MANAGER=y
CONFIG_STREAM_FLASH=y
CONFIG_DFU_TARGET_MCUBOOT=y
CONFIG_IMG_ERASE_PROGRESSIVELY=y
CONFIG_ZIGBEE_FOTA_PROGRESS_EVT=y

# Increase the number of RX buffers
CONFIG_NRF_802154_RX_BUFFERS=32
```

## src/main.c
```c
#include <math.h>
#include <prstlib/adc.h>
#include <prstlib/button.h>
#include <prstlib/led.h>
#include <prstlib/macros.h>
#include <prstlib/sensors.h>
#include <prstlib/shtc3.h>
#include <ram_pwrdn.h>
#include <zb_nrf_platform.h>
#include <zboss_api.h>
#include <zboss_api_addons.h>
#include <zcl/zb_zcl_power_config.h>
#include <zephyr/drivers/hwinfo.h>
#include <zephyr/kernel.h>
#include <zephyr/logging/log.h>
#include <zigbee/zigbee_app_utils.h>
#include <zigbee/zigbee_error_handler.h>

#if CONFIG_ZIGBEE_FOTA
#include <zephyr/dfu/mcuboot.h>
#include <zephyr/sys/reboot.h>
#include <zigbee/zigbee_fota.h>
#endif

#include "debug_counters.h"
#include "factory_reset.h"
#include "flash_fs.h"
#include "prst_zb_attrs.h"
#include "prst_zb_endpoint_defs.h"
#include "prst_zb_soil_moisture_defs.h"
#include "restart_handler.h"
#include "watchdog.h"

LOG_MODULE_REGISTER(app, CONFIG_LOG_DEFAULT_LEVEL);

static struct zb_device_ctx dev_ctx;

static prst_sensors_t sensors;

static bool joining_signal_received = false;
static bool stack_initialised = false;

static void led_flashing_cb(struct k_timer *timer) {
  prst_led_toggle();
}

K_TIMER_DEFINE(led_flashing_timer, led_flashing_cb, /*stop_fn=*/NULL);

ZB_ZCL_DECLARE_IDENTIFY_ATTRIB_LIST(
    identify_attr_list,
    &dev_ctx.identify_attr.identify_time);

ZB_ZCL_DECLARE_BASIC_ATTRIB_LIST_EXT(
    basic_attr_list,
    &dev_ctx.basic_attr.zcl_version,
    &dev_ctx.basic_attr.app_version,
    &dev_ctx.basic_attr.stack_version,
    &dev_ctx.basic_attr.hw_version,
    &dev_ctx.basic_attr.mf_name,
    &dev_ctx.basic_attr.model_id,
    &dev_ctx.basic_attr.date_code,
    &dev_ctx.basic_attr.power_source,
    &dev_ctx.basic_attr.location_id,
    &dev_ctx.basic_attr.ph_env,
    &dev_ctx.basic_attr.sw_ver);

ZB_ZCL_DECLARE_TEMP_MEASUREMENT_ATTRIB_LIST(temp_measurement_attr_list,
                                            &dev_ctx.temp_measure_attrs.measure_value,
                                            &dev_ctx.temp_measure_attrs.min_measure_value,
                                            &dev_ctx.temp_measure_attrs.max_measure_value,
                                            &dev_ctx.temp_measure_attrs.tolerance);

ZB_ZCL_DECLARE_REL_HUMIDITY_MEASUREMENT_ATTRIB_LIST(
    rel_humi_attr_list,
    &dev_ctx.rel_humidity_attrs.rel_humidity,
    &dev_ctx.rel_humidity_attrs.min_val,
    &dev_ctx.rel_humidity_attrs.max_val);

// https://devzone.nordicsemi.com/f/nordic-q-a/85315/zboss-declare-power-config-attribute-list-for-battery-bat_num
#define bat_num
ZB_ZCL_DECLARE_POWER_CONFIG_BATTERY_ATTRIB_LIST_EXT(
    batt_attr_list,
    &dev_ctx.batt_attrs.voltage,
    /*battery_size=*/&dev_ctx.batt_attrs.size,
    /*battery_quantity=*/&dev_ctx.batt_attrs.quantity,
    /*battery_rated_voltage=*/NULL,
    /*battery_alarm_mask=*/NULL,
    /*battery_voltage_min_threshold=*/NULL,
    /*battery_percentage_remaining=*/&dev_ctx.batt_attrs.percentage,
    /*battery_voltage_threshold1=*/NULL,
    /*battery_voltage_threshold2=*/NULL,
    /*battery_voltage_threshold3=*/NULL,
    /*battery_percentage_min_threshold=*/NULL,
    /*battery_percentage_threshold1=*/NULL,
    /*battery_percentage_threshold2=*/NULL,
    /*battery_percentage_threshold3=*/NULL,
    /*battery_alarm_state=*/NULL);

PRST_ZB_ZCL_DECLARE_SOIL_MOISTURE_ATTRIB_LIST(
    soil_moisture_attr_list,
    &dev_ctx.soil_moisture_attrs.percentage);

ZB_ZCL_DECLARE_ILLUMINANCE_MEASUREMENT_ATTRIB_LIST(
    illuminance_attr_list,
    /*value=*/&dev_ctx.illuminance_attrs.log_lux,
    /*min_value=*/NULL,
    /*max_value*/ NULL);

PRST_ZB_DECLARE_CLUSTER_LIST(
    app_template_clusters,
    basic_attr_list,
    identify_attr_list,
    temp_measurement_attr_list,
    rel_humi_attr_list,
    batt_attr_list,
    soil_moisture_attr_list,
    illuminance_attr_list);

PRST_ZB_DECLARE_ENDPOINT(
    app_template_ep,
    PRST_ZIGBEE_ENDPOINT,
    app_template_clusters);

#ifndef CONFIG_ZIGBEE_FOTA
ZBOSS_DECLARE_DEVICE_CTX_1_EP(
    app_template_ctx,
    app_template_ep);
#else

extern zb_af_endpoint_desc_t zigbee_fota_client_ep;

ZBOSS_DECLARE_DEVICE_CTX_2_EP(
    app_template_ctx,
    zigbee_fota_client_ep,
    app_template_ep);

static void confirm_image(void) {
  if (!boot_is_img_confirmed()) {
    int ret = boot_write_img_confirmed();

    if (ret) {
      LOG_ERR("Couldn't confirm image: %d", ret);
    } else {
      LOG_INF("Marked image as OK");
    }
  }
}

static void ota_evt_handler(const struct zigbee_fota_evt *evt) {
  switch (evt->id) {
    case ZIGBEE_FOTA_EVT_PROGRESS:
      prst_led_flash(1);
      break;
    case ZIGBEE_FOTA_EVT_FINISHED:
      LOG_INF("Reboot application.");
      /* Power on unused sections of RAM to allow MCUboot to use it. */
      if (IS_ENABLED(CONFIG_RAM_POWER_DOWN_LIBRARY)) {
        power_up_unused_ram();
      }
      sys_reboot(SYS_REBOOT_COLD);
      break;

    case ZIGBEE_FOTA_EVT_ERROR:
      LOG_ERR("OTA image transfer failed.");
      break;
  }
}

static void zcl_device_cb(zb_bufid_t bufid) {
  zb_zcl_device_callback_param_t *device_cb_param =
      ZB_BUF_GET_PARAM(bufid, zb_zcl_device_callback_param_t);

  if (device_cb_param->device_cb_id == ZB_ZCL_OTA_UPGRADE_VALUE_CB_ID) {
    zigbee_fota_zcl_cb(bufid);
  } else {
    device_cb_param->status = RET_NOT_IMPLEMENTED;
  }
}
#endif /* CONFIG_ZIGBEE_FOTA */

void identify_cb(zb_bufid_t bufid) {
  LOG_DBG("Remote identify command called");
  prst_led_flash(15);
}

void update_sensors_cb(zb_uint8_t arg) {
  LOG_DBG("Updating sensors");

  // Reschedule the same callback.
  zb_ret_t ret = ZB_SCHEDULE_APP_ALARM(
      update_sensors_cb,
      /*param=*/0,
      ZB_MILLISECONDS_TO_BEACON_INTERVAL(1000 * CONFIG_PRST_ZB_SLEEP_DURATION_SEC));
  if (ret != RET_OK) {
    prst_debug_counters_increment("sens_cb_schedule_err");
    __ASSERT(false, "Unable to schedule sensor update callback");
  }

  __ASSERT(!prst_watchdog_feed(), "Failed to feed watchdog");

  prst_debug_counters_increment("sensors_read_before");
  if (prst_sensors_read_all(&sensors)) {
    prst_debug_counters_increment("sensors_read_error");
    __ASSERT(false, "Unable to read sensors");
  }
  prst_debug_counters_increment("sensors_read_after");

  // Battery voltage in units of 100 mV.
  uint8_t batt_voltage = sensors.batt.adc_read.millivolts / 100;
  prst_zb_set_attr_value(ZB_ZCL_CLUSTER_ID_POWER_CONFIG,
                         ZB_ZCL_ATTR_POWER_CONFIG_BATTERY_VOLTAGE_ID,
                         &batt_voltage);

  // Battery percentage in units of 0.5%.
  zb_uint8_t batt_percentage = 2 * 100 * sensors.batt.percentage;
  prst_zb_set_attr_value(ZB_ZCL_CLUSTER_ID_POWER_CONFIG,
                         ZB_ZCL_ATTR_POWER_CONFIG_BATTERY_PERCENTAGE_REMAINING_ID,
                         &batt_percentage);

  // Temperature in units of 0.01 degrees Celcius.
  zb_int16_t temperature_value = 100 * sensors.shtc3.temp_c;
  prst_zb_set_attr_value(ZB_ZCL_CLUSTER_ID_TEMP_MEASUREMENT,
                         ZB_ZCL_ATTR_TEMP_MEASUREMENT_VALUE_ID,
                         &temperature_value);

  // Relative humidity in units of 0.01%.
  zb_int16_t rel_humi = 100 * 100 * sensors.shtc3.rel_humi;
  prst_zb_set_attr_value(ZB_ZCL_CLUSTER_ID_REL_HUMIDITY_MEASUREMENT,
                         ZB_ZCL_ATTR_REL_HUMIDITY_MEASUREMENT_VALUE_ID,
                         &rel_humi);

  // Soil moisture in units of 0.01%.
  zb_int16_t soil_moisture = 100 * 100 * sensors.soil.percentage;
  prst_zb_set_attr_value(PRST_ZB_ZCL_ATTR_SOIL_MOISTURE_CLUSTER_ID,
                         PRST_ZB_ZCL_ATTR_SOIL_MOISTURE_VALUE_ID,
                         &soil_moisture);

  // Illuminance in 10000 * log_10(lux) + 1.
  zb_int16_t log_lux = 10000 * log10((float)sensors.photo.brightness) + 1;
  prst_zb_set_attr_value(ZB_ZCL_CLUSTER_ID_ILLUMINANCE_MEASUREMENT,
                         ZB_ZCL_ATTR_ILLUMINANCE_MEASUREMENT_MEASURED_VALUE_ID,
                         &log_lux);
}

void zboss_signal_handler(zb_bufid_t bufid) {
  // See zigbee_default_signal_handler() for all available signals.

#ifdef CONFIG_ZIGBEE_FOTA
  /* Pass signal to the OTA client implementation. */
  zigbee_fota_signal_handler(bufid);
#endif /* CONFIG_ZIGBEE_FOTA */

  zb_zdo_app_signal_hdr_t *sig_hndler = NULL;
  zb_zdo_app_signal_type_t sig = zb_get_app_signal(bufid, /*sg_p=*/&sig_hndler);
  zb_ret_t status = ZB_GET_APP_SIGNAL_STATUS(bufid);
  switch (sig) {
    case ZB_BDB_SIGNAL_STEERING:         // New network.
    case ZB_BDB_SIGNAL_DEVICE_REBOOT: {  // Previously joined network.
      LOG_DBG("Steering complete. Status: %d", status);
      if (status == RET_OK) {
        LOG_DBG("Steering successful. Status: %d", status);
        k_timer_stop(&led_flashing_timer);
        prst_led_off();
        prst_restart_watchdog_stop();
        // Update the long polling parent interval - needs to be done after joining.
        zb_zdo_pim_set_long_poll_interval(1000 * CONFIG_PRST_ZB_PARENT_POLL_INTERVAL_SEC);
      } else {
        LOG_DBG("Steering failed. Status: %d", status);
        prst_restart_watchdog_start();
        // Power saving.
        k_timer_stop(&led_flashing_timer);
        prst_led_off();
      }
      joining_signal_received = true;
      break;
    }
    case ZB_BDB_SIGNAL_DEVICE_FIRST_START:
      joining_signal_received = true;
      break;
    case ZB_ZDO_SIGNAL_LEAVE:
      if (status == RET_OK) {
        k_timer_start(&led_flashing_timer, K_NO_WAIT, K_SECONDS(1));
        zb_zdo_signal_leave_params_t *leave_params = ZB_ZDO_SIGNAL_GET_PARAMS(sig_hndler, zb_zdo_signal_leave_params_t);
        LOG_DBG("Network left (leave type: %d)", leave_params->leave_type);

        /* Set joining_signal_received to false so broken rejoin procedure can be detected correctly. */
        if (leave_params->leave_type == ZB_NWK_LEAVE_TYPE_REJOIN) {
          joining_signal_received = false;
        }
      }
      break;
    case ZB_ZDO_SIGNAL_SKIP_STARTUP: {
      stack_initialised = true;
      LOG_DBG("Started zigbee stack and waiting for connection to network.");
      k_timer_start(&led_flashing_timer, K_NO_WAIT, K_SECONDS(1));

      // Kick off main sensor update task.
      ZB_ERROR_CHECK(ZB_SCHEDULE_APP_ALARM(update_sensors_cb,
                                           /*param=*/0,
                                           ZB_MILLISECONDS_TO_BEACON_INTERVAL(1000)));
      __ASSERT_NO_MSG(!prst_watchdog_start());
      break;
    }
    case ZB_NLME_STATUS_INDICATION: {
      zb_zdo_signal_nlme_status_indication_params_t *nlme_status_ind =
          ZB_ZDO_SIGNAL_GET_PARAMS(sig_hndler, zb_zdo_signal_nlme_status_indication_params_t);
      if (nlme_status_ind->nlme_status.status == ZB_NWK_COMMAND_STATUS_PARENT_LINK_FAILURE) {
        /* Check for broken rejoin procedure and restart the device to recover.
           This implements Nordic's suggested workaround for errata KRKNWK-12017, which effects
           the recent nRF Connect SDK (v1.8.0 - v2.3.0 at time of writing).
           For details see: https://developer.nordicsemi.com/nRF_Connect_SDK/doc/latest/nrf/known_issues.html?v=v2-3-0
         */
        if (stack_initialised && !joining_signal_received) {
          zb_reset(0);
        }
      }
      break;
    }
  }

  ZB_ERROR_CHECK(zigbee_default_signal_handler(bufid));
  if (bufid) {
    zb_buf_free(bufid);
  }
}

void dump_counter(const char *counter_name, prst_debug_counter_t value) {
  LOG_INF("- %s: %d", counter_name, value);
}

int log_reset_reason_counter() {
  uint32_t cause;
  const char *reset_counter_str = "reset_cause_unknown";
  RET_IF_ERR(hwinfo_get_reset_cause(&cause));
  RET_IF_ERR(hwinfo_clear_reset_cause());
  if (cause & RESET_PIN) {
    reset_counter_str = "reset_cause_pin";
  } else if (cause & RESET_SOFTWARE) {
    // Includes fatal errors from __ASSERT, ZB_ERROR_CHECK and friends.
    reset_counter_str = "reset_cause_software";
  } else if (cause & RESET_BROWNOUT) {
    reset_counter_str = "reset_cause_brownout";
  } else if (cause & RESET_POR) {
    reset_counter_str = "reset_cause_power_on";
  } else if (cause & RESET_WATCHDOG) {
    reset_counter_str = "reset_cause_watchdog";
  } else if (cause & RESET_DEBUG) {
    reset_counter_str = "reset_cause_debug";
  } else if (cause & RESET_LOW_POWER_WAKE) {
    reset_counter_str = "reset_cause_low_power";
  } else if (cause & RESET_CPU_LOCKUP) {
    reset_counter_str = "reset_cause_cpu_lockup";
  } else if (cause & RESET_HARDWARE) {
    reset_counter_str = "reset_cause_hardware";
  } else if (cause & RESET_USER) {
    reset_counter_str = "reset_cause_user";
  }
  return prst_debug_counters_increment(reset_counter_str);
}

int main(void) {
  RET_IF_ERR(prst_adc_init());
  RET_IF_ERR(prst_led_init());
  RET_IF_ERR(prst_button_init());
  RET_IF_ERR(prst_flash_fs_init());
  RET_IF_ERR(prst_debug_counters_init());

  // Initialize sensors - quickly put them into low power mode.
  __ASSERT_NO_MSG(!prst_sensors_read_all(&sensors));

  prst_debug_counters_increment("boot");

  log_reset_reason_counter();

  LOG_INF("Dumping debug counters:");
  prst_debug_counters_get_all(dump_counter);

  __ASSERT_NO_MSG(!prst_zb_factory_reset_check());

  prst_zb_attrs_init(&dev_ctx);

  prst_led_flash(2);
  k_msleep(100);

  zigbee_configure_sleepy_behavior(/*enable=*/true);
  power_down_unused_ram();

#ifdef CONFIG_ZIGBEE_FOTA
  /* Initialize Zigbee FOTA download service. */
  zigbee_fota_init(ota_evt_handler);

  /* Mark the current firmware as valid. */
  confirm_image();

  /* Register callback for handling ZCL commands. */
  ZB_ZCL_REGISTER_DEVICE_CB(zcl_device_cb);
#endif /* CONFIG_ZIGBEE_FOTA */

  ZB_AF_REGISTER_DEVICE_CTX(&app_template_ctx);

  ZB_AF_SET_IDENTIFY_NOTIFICATION_HANDLER(PRST_ZIGBEE_ENDPOINT, identify_cb);

#ifdef CONFIG_ZIGBEE_FOTA
  ZB_AF_SET_IDENTIFY_NOTIFICATION_HANDLER(CONFIG_ZIGBEE_FOTA_ENDPOINT, identify_cb);
#endif

  zigbee_enable();

  prst_debug_counters_increment("main_finish");

  return 0;
}
```

## include/zb_range_extender.h
```c
/*
 * Copyright (c) 2022 Nordic Semiconductor ASA
 *
 * SPDX-License-Identifier: LicenseRef-Nordic-5-Clause
 */

#ifndef ZB_RANGE_EXTENDER_H
#define ZB_RANGE_EXTENDER_H 1

/**
 *  @defgroup ZB_DEFINE_DEVICE_RANGE_EXTENDER Range Extender
 *  @{
 *  @details
 *      - @ref ZB_ZCL_IDENTIFY \n
 *      - @ref ZB_ZCL_BASIC
 */

/** Range Extender Device ID*/
#define ZB_RANGE_EXTENDER_DEVICE_ID 0x0008

/** Range extender device version */
#define ZB_DEVICE_VER_RANGE_EXTENDER 0

/** @cond internals_doc */

/** Range extender IN (server) clusters number */
#define ZB_RANGE_EXTENDER_IN_CLUSTER_NUM 3

/** Range extender OUT (client) clusters number */
#define ZB_RANGE_EXTENDER_OUT_CLUSTER_NUM 0

#define ZB_RANGE_EXTENDER_CLUSTER_NUM \
  (ZB_RANGE_EXTENDER_IN_CLUSTER_NUM + ZB_RANGE_EXTENDER_OUT_CLUSTER_NUM)

/** Number of attribute for reporting on Range extender device */
#define ZB_RANGE_EXTENDER_REPORT_ATTR_COUNT 0

#define ZB_DECLARE_RANGE_EXTENDER_CLUSTER_LIST(                             \
    cluster_list_name,                                                      \
    basic_attr_list,                                                        \
    identify_attr_list,                                                     \
    temp_measurement_attr_list)                                             \
  zb_zcl_cluster_desc_t cluster_list_name[] =                               \
      {                                                                     \
          ZB_ZCL_CLUSTER_DESC(                                              \
              ZB_ZCL_CLUSTER_ID_IDENTIFY,                                   \
              ZB_ZCL_ARRAY_SIZE(identify_attr_list, zb_zcl_attr_t),         \
              (identify_attr_list),                                         \
              ZB_ZCL_CLUSTER_SERVER_ROLE,                                   \
              ZB_ZCL_MANUF_CODE_INVALID),                                   \
          ZB_ZCL_CLUSTER_DESC(                                              \
              ZB_ZCL_CLUSTER_ID_BASIC,                                      \
              ZB_ZCL_ARRAY_SIZE(basic_attr_list, zb_zcl_attr_t),            \
              (basic_attr_list),                                            \
              ZB_ZCL_CLUSTER_SERVER_ROLE,                                   \
              ZB_ZCL_MANUF_CODE_INVALID),                                   \
          ZB_ZCL_CLUSTER_DESC(                                              \
              ZB_ZCL_CLUSTER_ID_TEMP_MEASUREMENT,                           \
              ZB_ZCL_ARRAY_SIZE(temp_measurement_attr_list, zb_zcl_attr_t), \
              (temp_measurement_attr_list),                                 \
              ZB_ZCL_CLUSTER_SERVER_ROLE,                                   \
              ZB_ZCL_MANUF_CODE_INVALID)}

/** @cond internals_doc */

/**
 * @brief Declare simple descriptor for Range extender device
 * @param ep_name - endpoint variable name
 * @param ep_id - endpoint ID
 * @param in_clust_num - number of supported input clusters
 * @param out_clust_num - number of supported output clusters
 */
#define ZB_ZCL_DECLARE_RANGE_EXTENDER_SIMPLE_DESC(ep_name, ep_id, in_clust_num, out_clust_num) \
  ZB_DECLARE_SIMPLE_DESC(in_clust_num, out_clust_num);                                         \
  ZB_AF_SIMPLE_DESC_TYPE(in_clust_num, out_clust_num)                                          \
  simple_desc_##ep_name =                                                                      \
      {                                                                                        \
          ep_id,                                                                               \
          ZB_AF_HA_PROFILE_ID,                                                                 \
          ZB_RANGE_EXTENDER_DEVICE_ID,                                                         \
          ZB_DEVICE_VER_RANGE_EXTENDER,                                                        \
          0,                                                                                   \
          in_clust_num,                                                                        \
          out_clust_num,                                                                       \
          {ZB_ZCL_CLUSTER_ID_BASIC,                                                            \
           ZB_ZCL_CLUSTER_ID_IDENTIFY, ZB_ZCL_CLUSTER_ID_TEMP_MEASUREMENT}}

/** @endcond */ /* internals_doc */

/**
 * @brief Declare endpoint for Range extender device
 * @param ep_name - endpoint variable name
 * @param ep_id - endpoint ID
 * @param cluster_list - endpoint cluster list
 */
#define ZB_DECLARE_RANGE_EXTENDER_EP(ep_name, ep_id, cluster_list)                                                \
  ZB_ZCL_DECLARE_RANGE_EXTENDER_SIMPLE_DESC(ep_name, ep_id,                                                       \
                                            ZB_RANGE_EXTENDER_IN_CLUSTER_NUM, ZB_RANGE_EXTENDER_OUT_CLUSTER_NUM); \
  ZB_AF_DECLARE_ENDPOINT_DESC(ep_name, ep_id, ZB_AF_HA_PROFILE_ID, 0, NULL,                                       \
                              ZB_ZCL_ARRAY_SIZE(cluster_list, zb_zcl_cluster_desc_t), cluster_list,               \
                              (zb_af_simple_desc_1_1_t *)&simple_desc_##ep_name,                                  \
                              0, NULL, /* No reporting ctx */                                                     \
                              0, NULL) /* No CVC ctx */

/*! @} */

#endif /* ZB_RANGE_EXTENDER_H */
```

## src/debug_counters.c
```c
#include "debug_counters.h"

#include <prstlib/macros.h>
#include <zephyr/fs/fs.h>
#include <zephyr/fs/littlefs.h>
#include <zephyr/kernel.h>
#include <zephyr/logging/log.h>

LOG_MODULE_REGISTER(debug_counters, CONFIG_LOG_DEFAULT_LEVEL);

static const char kDebugCountersDir[] = "/lfs/debug_counters";

#define PRST_MAX_COUNTER_NAME_LENGTH 64
#define PRST_MAX_FILE_NAME_LENGTH (sizeof(kDebugCountersDir) + 1 + PRST_MAX_COUNTER_NAME_LENGTH)

static int mk_filename(const char* counter_name, char* buff, size_t buff_size) {
  RET_CHECK(strlen(counter_name) <= PRST_MAX_COUNTER_NAME_LENGTH, "Counter name too long");
  strcpy(buff, kDebugCountersDir);
  strcat(buff, "/");
  strcat(buff, counter_name);
  return 0;
}

static int read_counter_file(struct fs_file_t* file, prst_debug_counter_t* value) {
  int n_read = fs_read(file, value, sizeof(prst_debug_counter_t));
  if (n_read != sizeof(prst_debug_counter_t)) {
    LOG_WRN("fs_read returned %d, expected %d, assuming first access", n_read, sizeof(prst_debug_counter_t));
    *value = 0;
  }
  return 0;
}

int prst_debug_counters_init() {
  struct fs_dirent entry;
  int err = fs_stat(kDebugCountersDir, &entry);
  if (err == 0) {
    LOG_DBG("Directory %s already exists", kDebugCountersDir);
    return 0;
  } else if (err == -ENOENT) {
    LOG_DBG("Creating directory %s", kDebugCountersDir);
    return fs_mkdir(kDebugCountersDir);
  }
  LOG_ERR("Unexpected error in fs_stat for %s: %d", kDebugCountersDir, err);
  return err;
}

int prst_debug_counters_increment(const char* counter_name) {
  char filename[PRST_MAX_FILE_NAME_LENGTH];
  RET_IF_ERR(mk_filename(counter_name, filename, sizeof(filename)));

  LOG_DBG("Incrementing counter %s", filename);

  // Open the file.
  struct fs_file_t file;
  fs_file_t_init(&file);
  RET_IF_ERR(fs_open(&file, filename, FS_O_CREATE | FS_O_RDWR));
  // Read the current value.
  prst_debug_counter_t value;
  RET_IF_ERR(read_counter_file(&file, &value));
  // Increment the value.
  value++;
  // Write back to file.
  RET_CHECK(fs_seek(&file, 0, SEEK_SET) == 0, "Unable to seek");
  ssize_t written = fs_write(&file, &value, sizeof(value));
  if (written != sizeof(value)) {
    LOG_ERR("fs_write returned %d, expected %d", written, sizeof(value));
  }
  RET_IF_ERR(fs_sync(&file));
  return fs_close(&file);
}

int prst_debug_counters_get(const char* counter_name, prst_debug_counter_t* value) {
  char filename[PRST_MAX_FILE_NAME_LENGTH];
  RET_IF_ERR(mk_filename(counter_name, filename, sizeof(filename)));

  LOG_DBG("Getting counter %s", filename);

  // Open the file.
  struct fs_file_t file;
  fs_file_t_init(&file);
  RET_IF_ERR(fs_open(&file, filename, FS_O_CREATE | FS_O_READ));
  // Read the current value.
  RET_IF_ERR(read_counter_file(&file, value));
  return fs_close(&file);
}

int prst_debug_counters_get_all(prst_debug_counters_callback_t callback) {
  LOG_DBG("Getting all counters from %s", kDebugCountersDir);

  struct fs_dir_t dirp;
  fs_dir_t_init(&dirp);
  static struct fs_dirent entry;
  RET_IF_ERR(fs_opendir(&dirp, kDebugCountersDir));
  prst_debug_counter_t value;
  for (;;) {
    RET_IF_ERR(fs_readdir(&dirp, &entry));
    // End of directory;
    if (entry.name[0] == 0) {
      break;
    }
    LOG_DBG("Found %s", entry.name);
    prst_debug_counters_get(entry.name, &value);
    callback(entry.name, value);
  }
  return fs_closedir(&dirp);
}
```

## src/debug_counters.h
```c
#ifndef _PRST_DEBUG_COUNTERS_H_
#define _PRST_DEBUG_COUNTERS_H_

#include <stdint.h>

typedef uint32_t prst_debug_counter_t;

typedef void (*prst_debug_counters_callback_t)(const char* counter_name, prst_debug_counter_t value);

int prst_debug_counters_init();

int prst_debug_counters_increment(const char* counter_name);

int prst_debug_counters_increment_async(const char* counter_name);

int prst_debug_counters_get(const char* counter_name, prst_debug_counter_t* value);

int prst_debug_counters_get_all(prst_debug_counters_callback_t callback);

#endif  // _PRST_DEBUG_COUNTERS_H_
```

## src/double_reset_detector.c
```c
#include "double_reset_detector.h"

#include <prstlib/macros.h>
#include <string.h>
#include <zephyr/fs/fs.h>
#include <zephyr/fs/littlefs.h>
#include <zephyr/kernel.h>
#include <zephyr/logging/log.h>

#include "debug_counters.h"

LOG_MODULE_REGISTER(double_reset_detector, CONFIG_LOG_DEFAULT_LEVEL);

static const char *flag_filename = "/lfs/reset_flag";

static const char flag_prefix[] = "prst-rst-count";

static struct fs_file_t flag_file;

static int erase_flag() {
  return fs_unlink(flag_filename);
}

void erase_flag_callback(struct k_work *work) {
  LOG_INF("Erasing double reset flag.");
  if (erase_flag() != 0) {
    LOG_ERR("Error deleting flag");
  }
}

K_WORK_DELAYABLE_DEFINE(erase_flag_work, erase_flag_callback);

int prst_detect_double_reset(prst_double_reset_callback_t on_double_reset) {
  fs_file_t_init(&flag_file);

  RET_IF_ERR(fs_open(&flag_file, flag_filename, FS_O_CREATE | FS_O_RDWR));

  char buff[sizeof(flag_prefix)];
  RET_CHECK(fs_read(&flag_file, buff, sizeof(buff)) >= 0, "Unable to read file");

  // Consider it a double reset if the flag is present in the FS.
  if (strcmp(buff, flag_prefix) == 0) {
    RET_IF_ERR(fs_close(&flag_file));
    RET_IF_ERR(erase_flag());
    prst_debug_counters_increment("double_reset");
    return on_double_reset();
  }

  // Rewind file.
  RET_IF_ERR(fs_seek(&flag_file, 0, SEEK_SET));

  // Write the flag and erase it after some time.
  ssize_t written = fs_write(&flag_file, flag_prefix, sizeof(flag_prefix));
  if (written != sizeof(flag_prefix)) {
    LOG_ERR("fs_write returned %d, expected %d", written, sizeof(flag_prefix));
    return -1;
  }

  RET_IF_ERR(fs_close(&flag_file));

  // Schedule the erasure of the flag after some time.
  RET_CHECK(k_work_schedule(&erase_flag_work, K_SECONDS(5)) == 1,
            "Work not scheduled");

  return 0;
}
```

## src/double_reset_detector.h
```c
#ifndef _PRST_ZB_DOUBLE_RESET_DETECTOR_H_
#define _PRST_ZB_DOUBLE_RESET_DETECTOR_H_

typedef int (*prst_double_reset_callback_t)();

int prst_detect_double_reset(prst_double_reset_callback_t on_double_reset);

#endif  // _PRST_ZB_DOUBLE_RESET_DETECTOR_H_
```

## src/factory_reset.c
```c
#include "factory_reset.h"

#include <hal/nrf_power.h>
#include <prstlib/button.h>
#include <prstlib/led.h>
#include <zephyr/logging/log.h>
#include <zigbee/zigbee_app_utils.h>

#include "double_reset_detector.h"

LOG_MODULE_REGISTER(factory_reset, CONFIG_LOG_DEFAULT_LEVEL);

static int factory_reset() {
  LOG_WRN("Factory resetting device");
  zb_bdb_reset_via_local_action(/*param=*/0);
  return 0;
}

#if CONFIG_PRST_ZB_FACTORY_RESET_VIA_DOUBLE_RESET
int double_reset_handler() {
  LOG_WRN("Called double reset handler");
  prst_led_flash(5);
  return factory_reset();
}
#endif  // CONFIG_PRST_ZB_FACTORY_RESET_VIA_DOUBLE_RESET

#if CONFIG_PRST_ZB_FACTORY_RESET_VIA_RESET_PIN
static int factory_reset_if_reset_via_reset_pin() {
  uint32_t reset_reason = nrf_power_resetreas_get(NRF_POWER);
  // If we're resetting via the RESET pin (e.g.: reset pin shorting, firmware flashing).
  if (reset_reason & 0x1) {
    LOG_WRN("Manual reset / re-flashing detected - erasing pairing info");
    return factory_reset();
  } else {  // It's a power-on cycle (e.g.: swapping battery, first boot).
    LOG_INF("Power-on cycle - keeping pairing info");
  }
  return 0;
}
#endif  // CONFIG_PRST_ZB_FACTORY_RESET_VIA_RESET_PIN

#if CONFIG_PRST_ZB_FACTORY_RESET_VIA_SW1
static void timer_do_reset(zb_uint8_t unused_param) {
  LOG_WRN("SW1 button was pressed for 5 seconds, factory resetting device");
  prst_led_flash(/*times=*/5);
  factory_reset();
}

static void sw1_factory_reset_check_timer_cb(struct k_timer *timer_id) {
  if (!prst_button_poll(PRST_BUTTON_SW1)) {
    LOG_DBG("SW1 button was released, will not factory reset device");
    return;
  }
  ZB_SCHEDULE_APP_CALLBACK(timer_do_reset, /*param=*/0);
}

K_TIMER_DEFINE(sw1_factory_reset_check_timer, sw1_factory_reset_check_timer_cb, NULL);
#endif

int prst_zb_factory_reset_check() {
#if CONFIG_PRST_ZB_FACTORY_RESET_VIA_DOUBLE_RESET
  return prst_detect_double_reset(double_reset_handler);
#elif CONFIG_PRST_ZB_FACTORY_RESET_VIA_RESET_PIN
  return factory_reset_if_reset_via_reset_pin();
#elif CONFIG_PRST_ZB_FACTORY_RESET_VIA_SW1
  if (prst_button_poll(PRST_BUTTON_SW1)) {
    LOG_DBG("SW1 pressed. Scheduling timer");
    k_timer_start(&sw1_factory_reset_check_timer, K_SECONDS(5), K_NO_WAIT);
  }
  return 0;
#elif CONFIG_PRST_ZB_FACTORY_RESET_DISABLED
  return 0;
#else
#error "No factory reset method selected -- explicitly select CONFIG_PRST_ZB_FACTORY_RESET_DISABLED=y to disable it"
#endif  // CONFIG_PRST_ZB_FACTORY_RESET_VIA_RESET_PIN
}
```

## src/factory_reset.h
```c
#ifndef _PRST_ZB_FACTORY_RESET_H_
#define _PRST_ZB_FACTORY_RESET_H_

int prst_zb_factory_reset_check();

#endif  // _PRST_ZB_FACTORY_RESET_H_
```

## src/flash_fs.c
```c
#include "flash_fs.h"

#include <prstlib/macros.h>
#include <zephyr/fs/fs.h>
#include <zephyr/fs/littlefs.h>
#include <zephyr/logging/log.h>

LOG_MODULE_REGISTER(flash_fs, CONFIG_LOG_DEFAULT_LEVEL);

FS_LITTLEFS_DECLARE_DEFAULT_CONFIG(storage);

static struct fs_mount_t lfs_storage_mnt = {
    .type = FS_LITTLEFS,
    .fs_data = &storage,
    .storage_dev = (void *)FIXED_PARTITION_ID(storage_partition),
    .mnt_point = "/lfs",
};

int prst_flash_fs_init() {
  // TODO: if booting for the first time after a full flash erase, fs_mount will
  // complain (via a LOG_ERR) and then automatically format the flash. It all works,
  // but avoiding a scary red message would be ideal. Maybe somehow check if it's
  // formatted before mounting?
  RET_IF_ERR(fs_mount(&lfs_storage_mnt));
  return 0;
}
```

## src/flash_fs.h
```c
#ifndef _PRST_FLASH_FS_H_
#define _PRST_FLASH_FS_H_

#include <stddef.h>

// Initializes and mounts littlefs.
int prst_flash_fs_init();

#endif  // _PRST_FLASH_FS_H_
```

## src/prst_zb_attrs.c
```c
#include "prst_zb_attrs.h"

#include <zboss_api_addons.h>

#include "prst_zb_endpoint_defs.h"

void prst_zb_attrs_init(struct zb_device_ctx *dev_ctx) {
  dev_ctx->basic_attr.zcl_version = ZB_ZCL_VERSION;
  dev_ctx->basic_attr.power_source = ZB_ZCL_BASIC_POWER_SOURCE_BATTERY;
  ZB_ZCL_SET_STRING_VAL(
      dev_ctx->basic_attr.mf_name,
      PRST_BASIC_MANUF_NAME,
      ZB_ZCL_STRING_CONST_SIZE(PRST_BASIC_MANUF_NAME));

  ZB_ZCL_SET_STRING_VAL(
      dev_ctx->basic_attr.model_id,
      CONFIG_PRST_ZB_MODEL_ID,
      ZB_ZCL_STRING_CONST_SIZE(CONFIG_PRST_ZB_MODEL_ID));

  ZB_ZCL_SET_STRING_VAL(
      dev_ctx->basic_attr.date_code,
      CONFIG_PRST_ZB_BUILD_DATE,
      ZB_ZCL_STRING_CONST_SIZE(CONFIG_PRST_ZB_BUILD_DATE));

  ZB_ZCL_SET_STRING_VAL(
      dev_ctx->basic_attr.sw_ver,
      CONFIG_PRST_ZB_SOFTWARE_VERSION,
      ZB_ZCL_STRING_CONST_SIZE(CONFIG_PRST_ZB_SOFTWARE_VERSION));

  dev_ctx->basic_attr.hw_version = CONFIG_PRST_ZB_HARDWARE_VERSION;

  dev_ctx->batt_attrs.quantity = 1;
  dev_ctx->batt_attrs.size = ZB_ZCL_POWER_CONFIG_BATTERY_SIZE_OTHER;

  dev_ctx->identify_attr.identify_time =
      ZB_ZCL_IDENTIFY_IDENTIFY_TIME_DEFAULT_VALUE;
}

zb_zcl_status_t prst_zb_set_attr_value(zb_uint16_t cluster_id, zb_uint16_t attr_id, void *data) {
  return zb_zcl_set_attr_val(PRST_ZIGBEE_ENDPOINT,
                             cluster_id,
                             ZB_ZCL_CLUSTER_SERVER_ROLE,
                             attr_id,
                             (zb_uint8_t *)data,
                             ZB_FALSE);
}
```

## src/prst_zb_attrs.h
```c
#ifndef _PRST_ZB_ATTRS_H_
#define _PRST_ZB_ATTRS_H_

#include <zboss_api_addons.h>

// Relative humimdity cluster - section 4.7.2.2.1.
typedef struct {
  // 100x relative humidity (mandatory).
  zb_uint16_t rel_humidity;
  // 0x0000 – 0x270f (mandatory).
  zb_uint16_t min_val;
  // 0x0001 – 0x2710 (mandatory).
  zb_uint16_t max_val;
} prst_rel_humidity_attrs_t;

// Power configuration cluster - section 3.3.2.2.3.
typedef struct {
  // Units of 100 mV. 0x00 - 0xff (optional, not reportable :()).
  zb_uint8_t voltage;
  // Units of 0.5%. 0x00 (0%) - 0xc8 (100%) (optional, reportable).
  zb_uint8_t percentage;
  // Whole number of battery cells used to power device
  zb_uint8_t quantity;
  // Enumeration of battery size
  enum zb_zcl_power_config_battery_size_e size;
} prst_batt_attrs_t;

// Soil moisture cluster.
typedef struct {
  // 0-100, units of 0.01?
  zb_uint16_t percentage;
} prst_soil_moisture_attrs_t;

// Illuminance cluster - section 4.2.2.2.
typedef struct {
  // 10000 * log_10(lux) + 1.
  zb_uint16_t log_lux;
} prst_illuminancce_attrs_t;

struct zb_device_ctx {
  zb_zcl_basic_attrs_ext_t basic_attr;
  zb_zcl_identify_attrs_t identify_attr;
  zb_zcl_temp_measurement_attrs_t temp_measure_attrs;
  prst_rel_humidity_attrs_t rel_humidity_attrs;
  prst_batt_attrs_t batt_attrs;
  prst_soil_moisture_attrs_t soil_moisture_attrs;
  prst_illuminancce_attrs_t illuminance_attrs;
};

int prst_zb_attrs_init(struct zb_device_ctx *dev_ctx);

zb_zcl_status_t prst_zb_set_attr_value(zb_uint16_t cluster_id, zb_uint16_t attr_id, void *data);

#endif  // _PRST_ZB_ATTRS_H_
```

## src/prst_zb_endpoint_defs.h
```c
#ifndef _PRST_ZB_H_
#define _PRST_ZB_H_

#include "prst_zb_soil_moisture_defs.h"

#define PRST_ZIGBEE_ENDPOINT 10
#define PRST_BASIC_MANUF_NAME "b-parasite"

#define PRST_ZB_DEVICE_ID 0x0008
#define PRST_ZB_DEVICE_VERSION 0
#define PRST_ZB_IN_CLUSTER_NUM 7
#define PRST_ZB_OUT_CLUSTER_NUM 0
#define PRST_ZB_CLUSTER_NUM (PRST_ZB_IN_CLUSTER_NUM + PRST_ZB_OUT_CLUSTER_NUM)
#define PRST_ZB_ATTR_REPORTING_COUNT 5

#define PRST_ZB_DECLARE_CLUSTER_LIST(                                       \
    cluster_list_name,                                                      \
    basic_attr_list,                                                        \
    identify_attr_list,                                                     \
    temp_measurement_attr_list,                                             \
    rel_humidity_attr_list,                                                 \
    batt_att_list,                                                          \
    soil_moisture_attr_list,                                                \
    illuminance_attr_list)                                                  \
  zb_zcl_cluster_desc_t cluster_list_name[] =                               \
      {                                                                     \
          ZB_ZCL_CLUSTER_DESC(                                              \
              ZB_ZCL_CLUSTER_ID_IDENTIFY,                                   \
              ZB_ZCL_ARRAY_SIZE(identify_attr_list, zb_zcl_attr_t),         \
              (identify_attr_list),                                         \
              ZB_ZCL_CLUSTER_SERVER_ROLE,                                   \
              ZB_ZCL_MANUF_CODE_INVALID),                                   \
          ZB_ZCL_CLUSTER_DESC(                                              \
              ZB_ZCL_CLUSTER_ID_BASIC,                                      \
              ZB_ZCL_ARRAY_SIZE(basic_attr_list, zb_zcl_attr_t),            \
              (basic_attr_list),                                            \
              ZB_ZCL_CLUSTER_SERVER_ROLE,                                   \
              ZB_ZCL_MANUF_CODE_INVALID),                                   \
          ZB_ZCL_CLUSTER_DESC(                                              \
              ZB_ZCL_CLUSTER_ID_TEMP_MEASUREMENT,                           \
              ZB_ZCL_ARRAY_SIZE(temp_measurement_attr_list, zb_zcl_attr_t), \
              (temp_measurement_attr_list),                                 \
              ZB_ZCL_CLUSTER_SERVER_ROLE,                                   \
              ZB_ZCL_MANUF_CODE_INVALID),                                   \
          ZB_ZCL_CLUSTER_DESC(                                              \
              ZB_ZCL_CLUSTER_ID_REL_HUMIDITY_MEASUREMENT,                   \
              ZB_ZCL_ARRAY_SIZE(rel_humidity_attr_list, zb_zcl_attr_t),     \
              (rel_humi_attr_list),                                         \
              ZB_ZCL_CLUSTER_SERVER_ROLE,                                   \
              ZB_ZCL_MANUF_CODE_INVALID),                                   \
          ZB_ZCL_CLUSTER_DESC(                                              \
              PRST_ZB_ZCL_ATTR_SOIL_MOISTURE_CLUSTER_ID,                    \
              ZB_ZCL_ARRAY_SIZE(soil_moisture_attr_list, zb_zcl_attr_t),    \
              (soil_moisture_attr_list),                                    \
              ZB_ZCL_CLUSTER_SERVER_ROLE,                                   \
              ZB_ZCL_MANUF_CODE_INVALID),                                   \
          ZB_ZCL_CLUSTER_DESC(                                              \
              ZB_ZCL_CLUSTER_ID_ILLUMINANCE_MEASUREMENT,                    \
              ZB_ZCL_ARRAY_SIZE(illuminance_attr_list, zb_zcl_attr_t),      \
              (illuminance_attr_list),                                      \
              ZB_ZCL_CLUSTER_SERVER_ROLE,                                   \
              ZB_ZCL_MANUF_CODE_INVALID),                                   \
          ZB_ZCL_CLUSTER_DESC(                                              \
              ZB_ZCL_CLUSTER_ID_POWER_CONFIG,                               \
              ZB_ZCL_ARRAY_SIZE(batt_attr_list, zb_zcl_attr_t),             \
              (batt_attr_list),                                             \
              ZB_ZCL_CLUSTER_SERVER_ROLE,                                   \
              ZB_ZCL_MANUF_CODE_INVALID)}

#define PRST_ZB_DECLARE_SIMPLE_DESC(ep_name, ep_id, in_clust_num, out_clust_num) \
  ZB_DECLARE_SIMPLE_DESC(in_clust_num, out_clust_num);                           \
  ZB_AF_SIMPLE_DESC_TYPE(in_clust_num, out_clust_num)                            \
  simple_desc_##ep_name =                                                        \
      {                                                                          \
          ep_id,                                                                 \
          ZB_AF_HA_PROFILE_ID,                                                   \
          PRST_ZB_DEVICE_ID,                                                     \
          PRST_ZB_DEVICE_VERSION,                                                \
          0,                                                                     \
          in_clust_num,                                                          \
          out_clust_num,                                                         \
          {                                                                      \
              ZB_ZCL_CLUSTER_ID_BASIC,                                           \
              ZB_ZCL_CLUSTER_ID_IDENTIFY,                                        \
              ZB_ZCL_CLUSTER_ID_TEMP_MEASUREMENT,                                \
              ZB_ZCL_CLUSTER_ID_REL_HUMIDITY_MEASUREMENT,                        \
              PRST_ZB_ZCL_ATTR_SOIL_MOISTURE_CLUSTER_ID,                         \
              ZB_ZCL_CLUSTER_ID_ILLUMINANCE_MEASUREMENT,                         \
              ZB_ZCL_CLUSTER_ID_POWER_CONFIG,                                    \
          }}

#define PRST_ZB_DECLARE_ENDPOINT(ep_name, ep_id, cluster_list)                                      \
  ZBOSS_DEVICE_DECLARE_REPORTING_CTX(reporting_ctx_##ep_name, PRST_ZB_ATTR_REPORTING_COUNT);        \
  PRST_ZB_DECLARE_SIMPLE_DESC(ep_name, ep_id,                                                       \
                              PRST_ZB_IN_CLUSTER_NUM, PRST_ZB_OUT_CLUSTER_NUM);                     \
  ZB_AF_DECLARE_ENDPOINT_DESC(ep_name, ep_id, ZB_AF_HA_PROFILE_ID,                                  \
                              /*reserved_length=*/0, /*reserved_ptr=*/NULL,                         \
                              ZB_ZCL_ARRAY_SIZE(cluster_list, zb_zcl_cluster_desc_t), cluster_list, \
                              (zb_af_simple_desc_1_1_t *)&simple_desc_##ep_name,                    \
                              PRST_ZB_ATTR_REPORTING_COUNT, reporting_ctx_##ep_name,                \
                              /*lev_ctrl_count=*/0, /*lev_ctrl_ctx=*/NULL)

#endif  // _PRST_ZB_H_
```
